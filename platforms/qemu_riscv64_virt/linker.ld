OUTPUT_ARCH(riscv)
ENTRY(_boot)

SECTIONS
{
    . = 0x80000000;

    .text : {
        *(.text._boot)
        *(.text)
        *(.text.*)
    }

    .rodata : {
        *(.rodata)
        *(.rodata.*)
    }

    .data : {
        *(.data)
        *(.data.*)
    }

    .bss :
    {
        __bss_start = .;
        *(.bss)
        *(.bss.*)
        *(COMMON)
        __bss_end = .;
    }
}
